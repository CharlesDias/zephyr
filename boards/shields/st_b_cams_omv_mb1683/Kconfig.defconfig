## boards/shields/st_b_cams_omv_mb1683/Kconfig.defconfig
```kconfig
# Copyright (c) 2024 Charles Dias <charlesdias.cd@outlook.com>
# SPDX-License-Identifier: Apache-2.0

if SHIELD_ST_B_CAMS_OMV_MB1683

# Double frame buffer maintained by lvgl.
if LVGL

choice LV_COLOR_DEPTH
	default LV_COLOR_DEPTH_16
endchoice

endif # LVGL

endif # SHIELD_ST_B_CAMS_OMV_MB1683
```

## drivers/display/Kconfig.hx8379c
```kconfig
# Copyright (c) 2024 STMicroelectronics
# SPDX-License-Identifier: Apache-2.0

config HX8379C
	bool "HX8379C display driver"
	default y
	depends on DT_HAS_HIMAX_HX8379C_ENABLED
	select MIPI_DSI
	help
	  Enable driver for HX8379C display controller with MIPI-DSI interface.
	  HX8379C is a 480x480 RGB driver with 24-bit color depth.
```

## drivers/display/Kconfig.stm32_ltdc_custom
```kconfig
# STM32 LTDC Custom Display Driver

# Copyright (c) 2025 Charles Dias
# SPDX-License-Identifier: Apache-2.0

config STM32_LTDC_CUSTOM
	bool "STM32 LTDC Custom Display Driver"
	default y
	depends on DT_HAS_ST_STM32_LTDC_CUSTOM_ENABLED
	# select USE_STM32_HAL_DSI
	select USE_STM32_HAL_LTDC
	# select USE_STM32_HAL_DMA2D
	# select USE_STM32_HAL_GPIO
	select USE_STM32_HAL_PWR
	select USE_STM32_HAL_PWR_EX
	select USE_STM32_HAL_RCC
	select USE_STM32_HAL_CORTEX
	# select USE_STM32_HAL_ICACHE
	help
	  Enable driver for STM32 DSI display controller.
	  This driver provides a complete DSI display solution
	  including panel initialization for STM32 MCUs.

if STM32_LTDC_CUSTOM

choice STM32_LTDC_PIXEL_FORMAT
	prompt "Color pixel format"
	default STM32_LTDC_RGB565
	depends on STM32_LTDC_CUSTOM
	help
	  Specify the color pixel format for the STM32 LCD-TFT display controller.

config STM32_LTDC_ARGB8888
	bool "ARGB8888"
	help
	  One pixel consists of 8-bit alpha, 8-bit red, 8-bit green and 8-bit blue value
	  (4 bytes per pixel)

config STM32_LTDC_RGB888
	bool "RGB888"
	help
	  One pixel consists of 8-bit red, 8-bit green and 8-bit blue value
	  (3 bytes per pixel)

config STM32_LTDC_RGB565
	bool "RGB565"
	help
	  One pixel consists of 5-bit red, 6-bit green and 5-bit blue value
	  (2 bytes per pixel)

endchoice

config STM32_LTDC_FB_NUM
	int "Frame buffer number"
	default 1
	range 0 2
	help
	  STM32 LTDC frame buffer number config:
	    - 0 frame buffer maintained by application, must write with full screen pixels.
	    - 1 single frame buffer in stm32 ltdc driver.
	    - 2 double frame buffer in stm32 ltdc driver.

config STM32_LTDC_FB_USE_SHARED_MULTI_HEAP
	bool "Use shared multi heap for the display buffer"

# config STM32_LTDC_FB_NUM
# 	int "Frame buffer number"
# 	default 1
# 	range 0 2
# 	help
# 	  STM32 LTDC frame buffer number config:
# 	    - 0 frame buffer maintained by application, must write with full screen pixels.
# 	    - 1 single frame buffer in stm32 ltdc driver.
# 	    - 2 double frame buffer in stm32 ltdc driver.

# config STM32_LTDC_FB_USE_SHARED_MULTI_HEAP
# 	bool "Use shared multi heap for the display buffer"

# config STM32_LTDC_FB_SMH_ATTRIBUTE
# 	int "Shared multi heap attribute for the display buffer"
# 	depends on STM32_LTDC_FB_USE_SHARED_MULTI_HEAP
# 	default 0
# 	range 0 2
# 	help
# 	  Shared multi heap attribute for the display buffer:
# 	  0: SMH_REG_ATTR_CACHEABLE
# 	  1: SMH_REG_ATTR_NON_CACHEABLE
# 	  2: SMH_REG_ATTR_EXTERNAL

# config STM32_LTDC_FB_SMH_ALIGN
# 	int "Shared multi heap buffer alignment for the display buffer"
# 	depends on STM32_LTDC_FB_USE_SHARED_MULTI_HEAP
# 	default 32

# config STM32_LTDC_DISABLE_FMC_BANK1
# 	bool "Disable FMC bank1 for STM32F7/H7 series"
# 	depends on SOC_SERIES_STM32H7X || SOC_SERIES_STM32F7X
# 	default y
# 	help
# 	  Disable FMC bank1 if not used to prevent speculative read accesses.
# 	  Refer to AN4861 "4.6 Special recommendations for Cortex-M7 (STM32F7/H7)".

endif # STM32_LTDC_CUSTOM
```

## drivers/mipi_dsi/Kconfig.stm32_custom
```kconfig
# Copyright (c) 2023 bytes at work AG
# SPDX-License-Identifier: Apache-2.0

config MIPI_DSI_STM32_CUSTOM
	bool "STM32 CUSTOM MIPI-DSI Host Controller"
	default y
	depends on DT_HAS_ST_STM32_CUSTOM_MIPI_DSI_ENABLED
	select USE_STM32_HAL_DSI
	help
	  STM32 CUSTOM MIPI DSI controller driver
```

## drivers/video/Kconfig.max96717
```kconfig
# Copyright (c) 2026 Charles Dias
# SPDX-License-Identifier: Apache-2.0

config VIDEO_MAX96717
	bool "ADI MAX96717 GMSL2 serializer"
	select I2C
	depends on DT_HAS_ADI_MAX96717_ENABLED
	default y
	help
	  Enable driver for the ADI MAX96717 GMSL2 serializer.
	  The MAX96717 receives MIPI CSI-2 data from a camera sensor
	  and transmits it over a coaxial GMSL2 link.

if VIDEO_MAX96717

config VIDEO_MAX96717_INIT_PRIORITY
	int "MAX96717 init priority"
	default 59
	help
	  Initialization priority for the MAX96717 serializer. This should be
	  higher than the deserializer's and lower than camera sensor priority
	  to ensure proper initialization order.

config VIDEO_MAX96717_PATGEN_ENABLE
	bool "Enable MAX96717 internal Video Pattern Generator (PATGEN)"
	default n
	help
	  Configure the MAX96717's internal pattern generator at probe time
	  to emit a synthetic 800x480 RGB888 frame over GMSL. Used to
	  validate the full SerDes path when no real image sensor is wired
	  to the serializer.

choice VIDEO_MAX96717_PATGEN_PATTERN
	prompt "MAX96717 PATGEN test pattern"
	depends on VIDEO_MAX96717_PATGEN_ENABLE
	default VIDEO_MAX96717_PATGEN_PATTERN_GRADIENT

config VIDEO_MAX96717_PATGEN_PATTERN_GRADIENT
	bool "Color gradient"

config VIDEO_MAX96717_PATGEN_PATTERN_CHECKERBOARD
	bool "Checkerboard"

endchoice

endif
```

## drivers/video/Kconfig.max96724
```kconfig
# Copyright (c) 2026 Charles Dias
# SPDX-License-Identifier: Apache-2.0

config VIDEO_MAX96724
	bool "ADI MAX96724 GMSL2 deserializer"
	select I2C
	depends on DT_HAS_ADI_MAX96724_ENABLED
	default y
	help
	  Enable driver for the ADI MAX96724 quad GMSL2 deserializer.
	  The MAX96724 receives video data over a GMSL2 coaxial link
	  and outputs it via MIPI CSI-2 D-PHY.

if VIDEO_MAX96724

config VIDEO_MAX96724_INIT_PRIORITY
	int "MAX96724 init priority"
	default 56
	help
	  Initialization priority for the MAX96724 deserializer. Must run
	  after the host I2C controller (typically priority 50) and before
	  the MAX96717 serializer (default 58), so that the deserializer's
	  I2C proxy is live when the serializer is probed through it.
	  Slot 57 is intentionally left free for any future driver that
	  needs to sit between the deserializer and the serializer.

endif
```

## drivers/video/Kconfig.stm32_dcmi
```kconfig
# STM32 DCMI driver configuration options

# Copyright (c) 2024 Charles Dias <charlesdias.cd@outlook.com>
# SPDX-License-Identifier: Apache-2.0

config VIDEO_STM32_DCMI
	bool "STM32 Digital camera interface (DCMI) driver"
	default y
	depends on DT_HAS_ST_STM32_DCMI_ENABLED
	select USE_STM32_HAL_DCMI
	select USE_STM32_HAL_DCMI_EX
	select USE_STM32_HAL_DMA
	select USE_STM32_HAL_DMA_EX
	# select DT_HAS_ST_STM32_DMAMUX_ENABLED/dma
	# select DT_HAS_ST_STM32_DMA_V1_ENABLED
	# select DT_HAS_ST_STM32_DMA_V2_ENABLED
	# select DT_HAS_ST_STM32_DMA_V2BIS_ENABLED
	# select DT_HAS_ST_STM32_BDMA_ENABLED
	# select CACHE_MANAGEMENT if CPU_HAS_DCACHE
	help
	  Enable driver for STM32 Digital camera interface periheral.
```

## dts/bindings/display/himax,hx8379c.yaml
```yaml
# Copyright (c) 2024 STMicroelectronics
# SPDX-License-Identifier: Apache-2.0

description: Himax HX8379C MIPI-DSI display panel

compatible: "himax,hx8379c"

include: [mipi-dsi-device.yaml]

properties:
  width:
    type: int
    required: true
    description: Panel width in pixels

  height:
    type: int
    required: true
    description: Panel height in pixels

  pixel-format:
    type: int
    required: true
    description: Pixel format as defined by MIPI-DSI specification

  data-lanes:
    required: true

  reset-gpios:
    type: phandle-array
    description: GPIO for panel reset pin

  bl-gpios:
    type: phandle-array
    description: GPIO for panel backlight enable pin
```

## dts/bindings/display/st,stm32-dsi-display.yaml
```yaml
# Copyright (c) 2025 Charles Dias
# SPDX-License-Identifier: Apache-2.0

description: STM32 DSI Display Driver

compatible: "st,stm32-dsi-display"

include: display-controller.yaml

properties:
  width:
    type: int
    required: true
    description: Panel width in pixels

  height:
    type: int
    required: true
    description: Panel height in pixels

  framebuffer-address:
    type: int
    required: true
    description: Physical address of the framebuffer memory

  pixel-format:
    type: int
    required: true
    description: |
      Pixel format as defined by LTDC constants:
      LTDC_PIXEL_FORMAT_ARGB8888 = 0
      LTDC_PIXEL_FORMAT_RGB888 = 1
      LTDC_PIXEL_FORMAT_RGB565 = 2

  reset-gpios:
    type: phandle-array
    description: Reset GPIO pin

  enable-gpios:
    type: phandle-array
    description: Enable GPIO pin

  backlight-gpios:
    type: phandle-array
    description: Backlight control GPIO pin
```

## dts/bindings/display/st,stm32_ltdc_custom.yaml
```yaml
# Copyright (c) 2025 Charles Dias
# SPDX-License-Identifier: Apache-2.0

description: STM32 LTDC Custom Display Driver

compatible: "st,stm32-ltdc-custom"

include: [lcd-controller.yaml, pinctrl-device.yaml, reset-device.yaml]

properties:
  clocks:
    required: true

  resets:
    required: true

  interrupts:
    required: true

  def-back-color-red:
    type: int
    description: Default display background color - red

  def-back-color-green:
    type: int
    description: Default display background color - green

  def-back-color-blue:
    type: int
    description: Default display background color - blue
```

## dts/bindings/video/adi,max96724.yaml
```yaml
#
# Copyright (c) 2026 Charles Dias
# SPDX-License-Identifier: Apache-2.0
#

description: ADI MAX96724 GMSL2 Deserializer

compatible: "adi,max96724"

include: i2c-device.yaml

child-binding:
  child-binding:
    child-binding:
      include: video-interfaces.yaml
```

## dts/bindings/video/st,stm32-dcmi.yaml
```yaml
#
# Copyright (c) 2024 Charles Dias <charlesdias.cd@outlook.com>
#
# SPDX-License-Identifier: Apache-2.0
#

description: ST Digital camera interface (DCMI)

compatible: "st,stm32-dcmi"

include: [base.yaml, pinctrl-device.yaml]

properties:
  interrupts:
    required: true

  sensor:
    required: true
    type: phandle
    description: phandle of connected sensor device
```

## samples/drivers/display/boards/stm32u5g9j_dk1.conf
```kconfig
CONFIG_DISPLAY=y
CONFIG_MIPI_DSI=y
CONFIG_MIPI_DSI_STM32=y
CONFIG_STM32_LTDC=y
CONFIG_GPIO=y
CONFIG_LOG=y
CONFIG_LOG_DEFAULT_LEVEL=3
CONFIG_MIPI_DSI_LOG_LEVEL_DBG=y
CONFIG_DISPLAY_LOG_LEVEL_DBG=y
# CONFIG_DISPLAY_LOG_LEVEL=4

CONFIG_DISPLAY_INIT_PRIORITY=86

# Increase log buffer to avoid dropping messages
CONFIG_LOG_MODE_DEFERRED=y
CONFIG_LOG_BUFFER_SIZE=5120

# Memory management for frame buffer (480x480x4 = ~900KB + overhead)
CONFIG_HEAP_MEM_POOL_SIZE=1048576

# Increase main stack size for DSI initialization
CONFIG_MAIN_STACK_SIZE=4096

# Enable ARGB8888 pixel format for STM32 LTDC
CONFIG_STM32_LTDC_ARGB8888=y

# Uncomment to set the number of frame buffers (0-2)
# This can help with double buffering or triple buffering scenarios.
CONFIG_STM32_LTDC_FB_NUM=1
```

## samples/drivers/mipi_dsi/test_hx8379c/sample.yaml
```yaml
sample:
  name: HX8379C MIPI DSI Display Test
  description: Test application for HX8379C MIPI DSI display panel

common:
  tags:
    - display
    - mipi_dsi
    - samples
    - drivers
  depends_on:
    - display
    - mipi_dsi
  harness: console
  harness_config:
    type: one_line
    regex:
      - "Display turned on successfully"

tests:
  sample.drivers.mipi_dsi.hx8379c:
    platform_allow:
      - stm32u5g9j_dk1
```

## samples/net/mqtt_publisher/boards/nucleo_f767zi.conf
```kconfig
# Networking Config:
CONFIG_NET_IPV4=y
CONFIG_NET_IPV6=n
CONFIG_NET_SOCKETS=y


# Disable unneeded settings from the base prj.conf:
# CONFIG_DNS_RESOLVER=n
CONFIG_NET_CONFIG_SETTINGS=n
CONFIG_NET_CONFIG_MY_IPV4_ADDR="192.168.15.102"
CONFIG_NET_CONFIG_PEER_IPV4_ADDR=""
```

## samples/subsys/display/lvgl/boards/stm32u5g9j_dk1.conf
```kconfig
CONFIG_LV_COLOR_DEPTH_32=y
#CONFIG_INPUT=y

CONFIG_DISPLAY=y
CONFIG_MIPI_DSI=y
CONFIG_STM32_LTDC_ARGB8888=y
CONFIG_STM32_LTDC_FB_NUM=0
CONFIG_HEAP_MEM_POOL_SIZE=65536

# Initialize after LTDC and MIPI-DSI
# CONFIG_DISPLAY_HX8379_INIT_PRIORITY=87
# CONFIG_HX8379=y

CONFIG_MIPI_DSI_LOG_LEVEL_DBG=y
CONFIG_LOG_BUFFER_SIZE=5120
#CONFIG_NO_OPTIMIZATIONS=y

CONFIG_LV_Z_VDB_SIZE=100
CONFIG_LV_Z_DOUBLE_VDB=y
#CONFIG_LV_Z_VBD_CUSTOM_SECTION=n
CONFIG_LV_Z_FULL_REFRESH=y
CONFIG_LV_Z_BITS_PER_PIXEL=32
CONFIG_LV_DPI_DEF=128
CONFIG_LV_Z_FLUSH_THREAD=y
```

## samples/subsys/video/capture/boards/nucleo_h743zi.conf
```kconfig
#
# Copyright (c) 2024 Charles Dias <charlesdias.cd@outlook.com>
#
# SPDX-License-Identifier: Apache-2.0
#

CONFIG_LOG_BUFFER_SIZE=2048

CONFIG_VIDEO_BUFFER_POOL_SZ_MAX=154624

# FIXME: remove this
CONFIG_DEBUG_OPTIMIZATIONS=y
CONFIG_DEBUG_THREAD_INFO=y
```

## samples/subsys/video/capture_to_lvgl/boards/stm32h7b3i_dk.conf
```kconfig
#
# Copyright (c) 2024 Charles Dias <charlesdias.cd@outlook.com>
#
# SPDX-License-Identifier: Apache-2.0
#

CONFIG_LOG_BUFFER_SIZE=2048

CONFIG_VIDEO_BUFFER_POOL_NUM_MAX=1

# CONFIG_VIDEO_BUFFER_POOL_SZ_MAX=614400
CONFIG_VIDEO_BUFFER_POOL_SZ_MAX=202400


CONFIG_DEBUG_OPTIMIZATIONS=y
```

## samples/subsys/video/tcpserversink/boards/nucleo_h743zi.conf
```kconfig
#
# Copyright (c) 2024 Charles Dias <charlesdias.cd@outlook.com>
#
# SPDX-License-Identifier: Apache-2.0
#

# Video buffer
CONFIG_VIDEO_BUFFER_POOL_SZ_MAX=154624

# Network buffers
CONFIG_NET_PKT_RX_COUNT=16
CONFIG_NET_PKT_TX_COUNT=32
CONFIG_NET_BUF_RX_COUNT=16
CONFIG_NET_BUF_TX_COUNT=32
CONFIG_NET_BUF_DATA_SIZE=128

# Network application options and configuration
CONFIG_NET_CONFIG_MY_IPV4_ADDR="192.168.15.2"
```
